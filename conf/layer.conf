## conf/layer.conf
```bitbake
BBPATH .= ":${LAYERDIR}"

BBFILES += "${LAYERDIR}/recipes-*/*/*.bb ${LAYERDIR}/recipes-*/*/*.bbappend"

BBFILE_COLLECTIONS += "wittypi"
BBFILE_PATTERN_wittypi = "^${LAYERDIR}/"

BBFILE_PRIORITY_wittypi = "12"

LAYERDEPENDS_wittypi = "core"

LAYERSERIES_COMPAT_wittypi = "scarthgap styhead walnascar wrynose"
```
